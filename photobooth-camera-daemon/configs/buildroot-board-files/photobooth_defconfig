## photobooth-camera-daemon/configs/buildroot-board-files/photobooth_defconfig
```kconfig
# Photobooth Buildroot Configuration
# Buildroot 2024.02.13
# Target: x86_64 VirtualBox VM for camera control

BR2_HAVE_DOT_CONFIG=y
BR2_HOST_GCC_AT_LEAST_11=y

# Architecture
BR2_ARCH_IS_64=y
BR2_USE_MMU=y
BR2_x86_64=y
BR2_ARCH="x86_64"
BR2_NORMALIZED_ARCH="x86_64"
BR2_ENDIAN="LITTLE"
BR2_GCC_TARGET_ARCH="x86-64"
BR2_BINFMT_ELF=y
BR2_x86_x86_64=y

# Toolchain
BR2_TOOLCHAIN=y
BR2_TOOLCHAIN_USES_GLIBC=y
BR2_TOOLCHAIN_BUILDROOT=y
BR2_TOOLCHAIN_BUILDROOT_VENDOR="photobooth"
BR2_TOOLCHAIN_BUILDROOT_GLIBC=y
BR2_TOOLCHAIN_BUILDROOT_LIBC="glibc"
BR2_KERNEL_HEADERS_AS_KERNEL=y
BR2_KERNEL_HEADERS_LATEST=y
BR2_PACKAGE_LINUX_HEADERS=y
BR2_BINUTILS_VERSION_2_40_X=y
BR2_BINUTILS_VERSION="2.40"
BR2_GCC_VERSION_12_X=y
BR2_GCC_VERSION="12.4.0"
BR2_TOOLCHAIN_BUILDROOT_CXX=y
BR2_USE_WCHAR=y
BR2_ENABLE_LOCALE=y
BR2_INSTALL_LIBSTDCPP=y
BR2_TOOLCHAIN_HAS_THREADS=y
BR2_TOOLCHAIN_HAS_THREADS_NPTL=y

# System
BR2_ROOTFS_SKELETON_DEFAULT=y
BR2_INIT_NONE=y
BR2_ROOTFS_DEVICE_CREATION_DYNAMIC_DEVTMPFS=y
BR2_TARGET_GENERIC_HOSTNAME="photobooth"
BR2_TARGET_GENERIC_ISSUE="Welcome to Photobooth Linux"
BR2_TARGET_ENABLE_ROOT_LOGIN=y
BR2_TARGET_GENERIC_ROOT_PASSWD=""
BR2_TARGET_GENERIC_REMOUNT_ROOTFS_RW=y
BR2_TARGET_GENERIC_GETTY_PORT="console"

# Rootfs Overlay
BR2_ROOTFS_OVERLAY="board/photobooth/overlay"

# Rootfs Format
BR2_TARGET_ROOTFS_CPIO=y
BR2_TARGET_ROOTFS_CPIO_FULL=y
BR2_TARGET_ROOTFS_CPIO_XZ=y
BR2_TARGET_ROOTFS_TAR=y

# Kernel
BR2_LINUX_KERNEL=y
BR2_LINUX_KERNEL_LATEST_VERSION=y
BR2_LINUX_KERNEL_VERSION="6.6.84"
BR2_LINUX_KERNEL_USE_CUSTOM_CONFIG=y
BR2_LINUX_KERNEL_CUSTOM_CONFIG_FILE="board/photobooth/linux.config"
BR2_LINUX_KERNEL_BZIMAGE=y
BR2_LINUX_KERNEL_GZIP=y
BR2_LINUX_KERNEL_INSTALL_TARGET=y

# Packages - Camera Support
BR2_PACKAGE_LIBUSB=y
BR2_PACKAGE_LIBGPHOTO2=y
BR2_PACKAGE_LIBXML2=y
BR2_PACKAGE_LIBTOOL=y
```
